## yocto/build/conf/bblayers.conf
```bitbake
# POKY_BBLAYERS_CONF_VERSION is increased each time build/conf/bblayers.conf
# changes incompatibly
POKY_BBLAYERS_CONF_VERSION = "2"

BBPATH = "${TOPDIR}"
BBFILES ?= ""

BBLAYERS ?= " \
  ${TOPDIR}/../poky/meta \
  ${TOPDIR}/../poky/meta-poky \
  ${TOPDIR}/../poky/meta-yocto-bsp \
  ${TOPDIR}/../meta-raspberrypi \
  ${TOPDIR}/../meta-openembedded/meta-oe \
  ${TOPDIR}/../meta-openembedded/meta-python \
  ${TOPDIR}/../meta-openembedded/meta-networking \
  ${TOPDIR}/../meta-openembedded/meta-multimedia \
  ${TOPDIR}/../meta-openembedded/meta-python2 \
  ${TOPDIR}/../meta-openembedded/meta-homeassistant \
  ${TOPDIR}/../meta-ivi/meta-ivi \
  ${TOPDIR}/../meta-qt5 \
  ${TOPDIR}/../meta-team1 \
  ${TOPDIR}/../meta-wayland \
  ${TOPDIR}/../meta-splash \
  ${TOPDIR}/../meta-piracer \
  ${TOPDIR}/../meta-pigpio \
  ${TOPDIR}/../meta-ui \
  ${TOPDIR}/../meta-wifi \
  "
```

## yocto/meta-WiFi/conf/layer.conf
```bitbake
BBPATH .= ":${LAYERDIR}"

BBFILES += "${LAYERDIR}/recipes*/*.bb \
            ${LAYERDIR}/recipes*/*/*.bbappend"

BBFILE_COLLECTIONS += "meta-WiFi"
BBFILE_PATTERN_meta-WiFi = "^${LAYERDIR}/"
BBFILE_PRIORITY_meta-WiFi = "10"
LAYERSERIES_COMPAT_meta-WiFi = "kirkstone"
```

## yocto/meta-display/conf/layer.conf
```bitbake
BBPATH =. "${LAYERDIR}:"
BBFILES += "${LAYERDIR}/recipes*/*/*/*.bb \
	    ${LAYERDIR}/recipes*/*/*.bbappend"

BBFILE_COLLECTIONS += "meta-display"
BBFILE_PATTERN_meta-display = "^${LAYERDIR}/"
BBFILE_PRIORITY_meta-display = "15"
LAYERSERIES_COMPAT_meta-team1 = "kirkstone"
```

## yocto/meta-hu/conf/layer.conf
```bitbake
BBPATH =. "${LAYERDIR}:"
BBFILES += "${LAYERDIR}/recipes*/*.bb \
	    ${LAYERDIR}/recipes*/*/*.bbappend"

BBFILE_COLLECTIONS += "meta-hu"
BBFILE_PATTERN_meta-hu = "^${LAYERDIR}/"
BBFILE_PRIORITY_meta-hu = "20"
LAYERSERIES_COMPAT_meta-hu = "kirkstone"
```

## yocto/meta-pigpio/conf/layer.conf
```bitbake
BBPATH =. "${LAYERDIR}:"
BBFILES += "${LAYERDIR}/recipes*/*.bb \
	    ${LAYERDIR}/recipes*/*/*.bbappend"

BBFILE_COLLECTIONS += "meta-pigpio"
BBFILE_PATTERN_meta-pigpio = "^${LAYERDIR}/"
BBFILE_PRIORITY_meta-pigpio = "5"
LAYERSERIES_COMPAT_meta-pigpio = "kirkstone"
```

## yocto/meta-piracer/conf/layer.conf
```bitbake
BBPATH =. "${LAYERDIR}:"
BBFILES += "${LAYERDIR}/recipes*/*.bb \
	    ${LAYERDIR}/recipes*/*/*.bbappend"

BBFILE_COLLECTIONS += "meta-piracer"
BBFILE_PATTERN_meta-piracer = "^${LAYERDIR}/"
BBFILE_PRIORITY_meta-piracer = "20"
LAYERSERIES_COMPAT_meta-piracer = "kirkstone"
```

## yocto/meta-splash/conf/layer.conf
```bitbake
BBPATH .= ":${LAYERDIR}"

BBFILES += "${LAYERDIR}/recipes*/*.bb \
            ${LAYERDIR}/recipes*/*/*.bbappend"

BBFILE_COLLECTIONS += "meta-splash"
BBFILE_PATTERN_meta-splash = "^${LAYERDIR}/"
BBFILE_PRIORITY_meta-splash = "7"
LAYERSERIES_COMPAT_meta-splash = "kirkstone"
```

## yocto/meta-team1/conf/layer.conf
```bitbake
BBPATH =. "${LAYERDIR}:"
BBFILES += "${LAYERDIR}/recipes*/*.bb \
	    ${LAYERDIR}/recipes*/*/*.bbappend"

BBFILE_COLLECTIONS += "meta-team1"
BBFILE_PATTERN_meta-team1 = "^${LAYERDIR}/"
BBFILE_PRIORITY_meta-team1 = "100"
LAYERSERIES_COMPAT_meta-team1 = "kirkstone"
```

## yocto/meta-ui/conf/layer.conf
```bitbake
BBPATH =. "${LAYERDIR}:"
BBFILES += "${LAYERDIR}/recipes*/*.bb \
	    ${LAYERDIR}/recipes*/*/*.bbappend"

BBFILE_COLLECTIONS += "meta-ui"
BBFILE_PATTERN_meta-ui = "^${LAYERDIR}/"
BBFILE_PRIORITY_meta-ui = "7"
LAYERSERIES_COMPAT_meta-ui = "kirkstone"
```

## yocto/meta-wifi/conf/layer.conf
```bitbake
BBPATH =. "${LAYERDIR}:"
BBFILES += "${LAYERDIR}/recipes*/*.bb \
	    ${LAYERDIR}/recipes*/*/*.bbappend"

BBFILE_COLLECTIONS += "meta-wifi"
BBFILE_PATTERN_meta-wifi = "^${LAYERDIR}/"
BBFILE_PRIORITY_meta-wifi = "20"
LAYERSERIES_COMPAT_meta-wifi = "kirkstone"
DEPENDS += "wpa-supplicant"
```
